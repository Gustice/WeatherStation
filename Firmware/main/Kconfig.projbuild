## Firmware/main/Kconfig.projbuild
```kconfig
menu "Device Configuration"
    config AP_MODE_WIFI_SSID
        string "WiFi SSID"
        default "SensNet"
        help
            SSID (network name) to generate a network in case no wifi parameters are given.

    config AP_MODE__WIFI_PASSWORD
        string "WiFi Password"
        default "connectMe"
        help
            WiFi password (WPA or WPA2) for the Access-Point mode.
            Password must be longer than 8 characters.

    config DEFAULT_BROKER_URL
        string "Broker URL"
        default "mqtt://myStation.fritz.box"
        help
            Default URL of the broker to connect to
endmenu
```

## Firmware/sdkconfig.defaults
```kconfig
### Wemos D1 mini config
CONFIG_ESPTOOLPY_FLASHSIZE_4MB=y
CONFIG_ESPTOOLPY_FLASHSIZE="4MB"
CONFIG_SPI_FLASH_SIZE=0x400000

CONFIG_LWIP_NETIF_LOOPBACK=y
CONFIG_LWIP_LOOPBACK_MAX_PBUFS=1

CONFIG_PARTITION_TABLE_CUSTOM=y
CONFIG_PARTITION_TABLE_CUSTOM_FILENAME="partitions.csv"
CONFIG_PARTITION_TABLE_FILENAME="partitions.csv"

CONFIG_DEFAULT_BROKER_URL="mqtt://raspberrypi.fritz.box"
# CONFIG_DEFAULT_BROKER_URL="mqtt://192.168.178.37"

CONFIG_NEWLIB_NANO_FORMAT=n
```
